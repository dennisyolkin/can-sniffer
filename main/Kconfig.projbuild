## main/Kconfig.projbuild
```kconfig
menu "Live view Wi-Fi"

    config LIVE_WIFI_SSID
        string "SSID"
        default "can-sniffer"
        help
            Network name of the board's access point. Max 32 characters.

    config LIVE_WIFI_PASSWORD
        string "Password"
        default ""
        help
            WPA2 passphrase, 8 to 63 characters. Empty makes the network open.
            Set it in sdkconfig.secrets (git-ignored), not in sdkconfig.defaults.

    config LIVE_WIFI_CHANNEL
        int "Channel"
        range 1 13
        default 1

    config LIVE_WIFI_MAX_CONNECTIONS
        int "Max connected stations"
        range 1 10
        default 3

    config LIVE_WIFI_MDNS_HOSTNAME
        string "mDNS hostname"
        default "can-sniffer"
        help
            Clients on the AP can reach the board as <hostname>.local (also always at 192.168.4.1).

endmenu

menu "CAN bus"

    config CAN_TX_MODE
        bool "TX mode: take part in the car's bus and send diagnostic requests"
        default y
        help
            On by default (the user's choice, 2026-11-21). Off: listen-only. TX is never routed to the TWAI
            controller; the node sends nothing, not even ACKs (build with -D LISTEN_ONLY_BUILD=1, see
            CMakeLists.txt).

            On: normal mode. The node ACKs every frame, sends error frames when it sees a bus error, and the page
            gets buttons for a fixed list of read-only, single-frame diagnostic requests (uds_client.c, allowlisted
            to UDS 0x3E/0x22/0x19, 0x10 default/extended and OBD-II mode 01). Nothing is sent unless a button on
            the page asks for it. Replies are shown on the page and logged to events.csv; the node
            receives its own requests back (loopback), so they also appear in can.log.

            Send requests parked (Ready on), and stop if bus errors appear.

endmenu
```
